## conf/layer.conf
```bitbake
# We have a conf and classes directory, add to BBPATH
BBPATH =. "${LAYERDIR}:"

# We have recipes-* directories, add to BBFILES
BBFILES += "${LAYERDIR}/recipes-*/*/*.bb \
            ${LAYERDIR}/recipes-*/*/*.bbappend"

BBFILE_COLLECTIONS += "intel-apollolake-i"
BBFILE_PATTERN_intel-apollolake-i := "^${LAYERDIR}/"
BBFILE_PRIORITY_intel-apollolake-i = "7"

# This should only be incremented on significant changes that will
# cause compatibility issues with other layers
LAYERVERSION_intel-apollolake-i = "1"

LAYERDEPENDS_intel-apollolake-i = "core wr-kernel"

PREMIRRORS_append := " \
        git://.*/.* file://${LAYERDIR}/downloads/ \n \
        svn://.*/.* file://${LAYERDIR}/downloads/ \n \
        ftp://.*/.* file://${LAYERDIR}/downloads/ \n \
        http://.*/.* file://${LAYERDIR}/downloads/ \n \
        https://.*/.* file://${LAYERDIR}/downloads/ \n \
"
```

## helios-extra/conf/layer.conf
```bitbake
# We have a conf and classes directory, add to BBPATH
BBPATH := "${LAYERDIR}:${BBPATH}"

# We have a packages directory, add to BBFILES
BBFILES := "${BBFILES} ${LAYERDIR}/recipes-*/*/*.bb \
            ${LAYERDIR}/recipes-*/*/*.bbappend"

BBFILE_COLLECTIONS += "watchdog-nowayout"
BBFILE_PATTERN_watchdog-nowayout := "^${LAYERDIR}/"
BBFILE_PRIORITY_watchdog-nowayout = "999"

# # Add scripts to PATH
# PATH := "${PATH}:${LAYERDIR}/scripts"

# # Add a directory to allow local changelist.xml changes
# WRL_CHANGELIST_PATH += "${LAYERDIR}/conf/image_final"
# 
# # Add a directory to allow local fs_final*.sh script changes
# WRL_FS_FINAL_PATH += "${LAYERDIR}/conf/image_final"

# We have a pre-populated downloads directory, add to PREMIRRORS
PREMIRRORS_append := "\
     git://.*/.* file://${LAYERDIR}/downloads/ \n \
     git://.*/.* git://${LAYERDIR}/git/BASENAME;protocol=file \n \
     svn://.*/.* file://${LAYERDIR}/downloads/ \n \
     ftp://.*/.* file://${LAYERDIR}/downloads/ \n \
     http://.*/.* file://${LAYERDIR}/downloads/ \n \
     https://.*/.* file://${LAYERDIR}/downloads/ \n"

# DISTRO_FEATURES_append = " wayland"
```
